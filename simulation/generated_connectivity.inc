* AUTO-GENERATED by tools/generate_connectivity.py. Do not edit.
* CONNECTIVITY_SHA256=d13e825ff8974e6b20e1ac9a9226f993307376337d7be4e2c34ad87381212739
* KICAD_ENDPOINT_SHA256=5c4c5236bcbccc4b56747ac95a52d39df47d0db434a9f67fe2ea545befa9f680
* Supply and RMT-controlled low-side emitter driver.
V3V3 +3V3 GND {VSUP}
VTX TX_CARRIER_GPIO1 GND PULSE(0 {VSUP} {SUPPLY_RISE} 2n 2n {DUTY/FCARRIER} {1/FCARRIER})
BESP +3V3 GND I=ternary_fcn(abs(time-{TRAN_STOP}/2)<{TRAN_STOP}*{WIFI_TX_DUTY}/2,{IESP_WIFI},{IESP_COMPUTE})
BCAN +3V3 GND I={CAN_ENABLE}*({ICAN_IDLE}+ternary_fcn(abs(time-{TRAN_STOP}/2)<{TRAN_STOP}*{CAN_BUS_DUTY}/2,{ICAN_DOMINANT_EXTRA},0))
IAFE +3V3 GND {IAFE_QUIESCENT}
RBASE TX_CARRIER_GPIO1 Q_BASE 1k
QTX LED_K_SWITCHED Q_BASE GND S8050
RHARNESS_K LED_K_SWITCHED LED_K_REMOTE 0.1584
RHARNESS_3V3 +3V3 +3V3_LED 0.1584
RLED +3V3_LED LED_A 39
DLED LED_A LED_K_REMOTE IRLED

* Reference, PIN photodiode and two TLV9062 channels.
RVR_TOP +3V3 VREF 10k
RVR_BOT VREF GND 10k
CVREF VREF GND 1u
BPHOTO +3V3 PD_ANODE I={IPHOTO_AMBIENT}+{IPHOTO_SIGNAL}*V(CARRIER)*V(SPOKE)
IDARK +3V3 PD_ANODE DC 1n
CPD PD_ANODE +3V3 3.3p
XU1A TIA_OUT VREF PD_ANODE +3V3 GND TLV9062_TYP
RF_TIA TIA_OUT PD_ANODE {RF_TIA}
CF_TIA TIA_OUT PD_ANODE {CF_TIA}
CAC TIA_OUT BP_IN {C_AC}
RAC BP_IN VREF {R_AC}
XU1B BANDPASS BP_IN BP_NEG +3V3 GND TLV9062_TYP
RG BP_NEG VREF {RG_GAIN}
RF BANDPASS BP_NEG {RF_GAIN}
CF BANDPASS BP_NEG {CF_GAIN}

* Comparator, hysteresis, GPIO isolation and local bypassing.
RCOMP_IN BANDPASS COMP_PLUS {R_COMP_IN}
RHYST COMP_OUT COMP_PLUS {R_HYST}
BCOMP COMP_IDEAL GND V={VSUP}/2*(1+tanh(350*(V(COMP_PLUS)-V(VREF))))
RDELAY COMP_IDEAL COMP_OUT 1k
CDELAY COMP_OUT GND {TPD_COMP/1000}
RGPIO COMP_OUT RX_RMT_GPIO2 100
CDEC_U1 +3V3 GND 100n
CDEC_U2 +3V3 GND 100n
